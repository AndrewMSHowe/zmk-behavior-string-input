## Kconfig
```kconfig
menu "String Input Options"

config ZMK_BEHAVIOR_STRING_INPUT_MAX_CONTINUE_LIST_SIZE
    int "Maximum number of keys in accept or cancel lists"
    default 5

#String Input Options
endmenu

DT_COMPAT_ZMK_BEHAVIOR_STRING_INPUT := zmk,behavior-string-input

config ZMK_BEHAVIOR_STRING_INPUT
    bool
    default $(dt_compat_enabled,$(DT_COMPAT_ZMK_BEHAVIOR_STRING_INPUT))
```

## dts/bindings/behaviors/zmk,behavior-string-input.yaml
```yaml
# Copyright (c) 2024 The ZMK Contributors
# SPDX-License-Identifier: MIT

description: String input behavior

compatible: "zmk,behavior-string-input"

include: zero_param.yaml

properties:
  bindings:
    type: phandles
    description: |
      <accept> <cancel>
      accept binding is passed the string as parameter when accept-keys are pressed.
      cancel binding is executed when cancel-keys are pressed.
    required: true
  accept-list:
    type: array
    description: |
      Keys that end string input and pass the string to the accept-bindings
    required: true
  cancel-list:
    type: array
    description: |
      Keys that end string input and execute cancel-bindings
    required: true
```
